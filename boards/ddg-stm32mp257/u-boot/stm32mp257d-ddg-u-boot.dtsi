#include "stm32mp25-u-boot.dtsi"

/ {
    config {
        u-boot,mmc-env-partition = "u-boot-env";
    };

    fwu-mdata {
        compatible = "u-boot,fwu-mdata-gpt";
        fwu-mdata-store = <&sdmmc2>;
    };
};
